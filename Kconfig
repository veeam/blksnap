## Kconfig
```kconfig
# SPDX-License-Identifier: GPL-2.0
#
# blk-snap block io layer filter module configuration
#
#
#select BLK_FILTER

config BLK_SNAP
	tristate "Block device snapshot filter"
	depends on BLK_FILTER

	help
	  Allow to create snapshots and track block changes for a block devices. 
```

## module/Kconfig
```kconfig
# SPDX-License-Identifier: GPL-2.0
#
# Block device snapshot module configuration
#

config BLK_SNAP
	tristate "Block Devices Snapshots Module (blksnap)"
	help
	  Allow to create snapshots and track block changes for block devices.
	  Designed for creating backups for simple block devices. Snapshots are
	  temporary and are released then backup is completed. Change block
	  tracking allows to create incremental or differential backups.
```
